## RPI1P2/scan/main/Kconfig.projbuild
```kconfig
menu "Example Configuration"

    config WIFI_SSID1
        string "1 - WiFi SSID"
        default "myssid"
        help
            SSID (network name) for the example to connect to.

    config WIFI_PASS1
        string "1 - WiFi Password"
        default "mypassword"
        help
            WiFi password (WPA or WPA2) for the example to use.
            
    config WIFI_SSID2
        string "2 - WiFi SSID"
        default ""
        help
            SSID (network name) for the example to connect to.

    config WIFI_PASS2
        string "2 - WiFi Password"
        default ""
        help
            WiFi password (WPA or WPA2) for the example to use.
            
    config WIFI_SSID3
        string "3 - WiFi SSID"
        default ""
        help
            SSID (network name) for the example to connect to.

    config WIFI_PASS3
        string "3 - WiFi Password"
        default ""
        help
            WiFi password (WPA or WPA2) for the example to use.

    config EXAMPLE_SCAN_LIST_SIZE
        int "Max size of scan list"
        range 0 20
        default 10
        help
            The size of array that will be used to retrieve the list of access points.

endmenu
```

## RPI1P6/gatt_client/main/Kconfig.projbuild
```kconfig
menu "Example Configuration"

    config EXAMPLE_DUMP_ADV_DATA_AND_SCAN_RESP
        bool "Dump whole adv data and scan response data in example"
        default n

    config KNOWN_BLE_DEVICE_MACS
        string "Direcciones MAC BLE conocidas"
        default NULL
        help
            Ingresa las direcciones MAC BLE conocidas, separadas por comas.

    config SCAN_TIME
        int "Tiempo de Escaneo (s)"
        default 5
        help
            Tiempo (en segundos) que el dispositivo ESP32 estará escaneando si no encuentra un dispositivo al que conectarse.
    
    config WAIT_TIME
        int "Tiempo de Espera (s)"
        default 10
        help
            Tiempo (en segundos) que el dispositivo ESP32 espera antes de iniciar un nuevo escaneo al no encontrar un dispositivo al que conectarse.
    
        
endmenu
```

## hello_world/main/Kconfig.projbuild
```kconfig
menu "Example Configuration"

    config RESET_TIME_1
        int "reset time in s for task 1"
        default 7 if IDF_TARGET_ESP32
        default 10
        help
            Reset time in s.

    config RESET_TIME_2
        int "reset time in s for task 2"
        default 5 if IDF_TARGET_ESP32
        default 8
        help
            Reset time in s.

endmenu
```
